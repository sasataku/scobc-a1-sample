#include <zephyr/dt-bindings/i2c/i2c.h>

/ {
	soc {
		i2c0: i2c@4f030000 {
			compatible = "sc,i2c";
			interrupts = <7 0>;
			reg = <0x4f030000 0x10000>;
			#address-cells = <1>;
			#size-cells = <0>;
			clock-frequency = <I2C_BITRATE_STANDARD>;
		};
	};
};
